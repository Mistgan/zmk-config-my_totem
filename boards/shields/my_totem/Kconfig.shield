## boards/shields/my_totem/Kconfig.shield
```kconfig
config SHIELD_MY_TOTEM_LEFT
    def_bool $(shields_list_contains,my_totem_left)
  
config SHIELD_MY_TOTEM_RIGHT
    def_bool $(shields_list_contains,my_totem_right)
  
```
